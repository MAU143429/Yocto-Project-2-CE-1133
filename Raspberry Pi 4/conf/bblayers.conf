## Raspberry Pi 4/conf/bblayers.conf
```bitbake
# POKY_BBLAYERS_CONF_VERSION is increased each time build/conf/bblayers.conf
# changes incompatibly
POKY_BBLAYERS_CONF_VERSION = "2"

BBPATH = "${TOPDIR}"
BBFILES ?= ""

BBLAYERS ?= " \
  /home/mau14/Desktop/SistemasEmpotrados/T6_Yocto_MauricioCalderon/poky/meta \
  /home/mau14/Desktop/SistemasEmpotrados/T6_Yocto_MauricioCalderon/poky/meta-poky \
  /home/mau14/Desktop/SistemasEmpotrados/T6_Yocto_MauricioCalderon/poky/meta-yocto-bsp \
  /home/mau14/Desktop/SistemasEmpotrados/T6_Yocto_MauricioCalderon/poky/meta-raspberrypi \
  /home/mau14/Desktop/SistemasEmpotrados/T6_Yocto_MauricioCalderon/poky/meta-webcam \
  /home/mau14/Desktop/SistemasEmpotrados/T6_Yocto_MauricioCalderon/meta-openembedded/meta-oe \
  /home/mau14/Desktop/SistemasEmpotrados/T6_Yocto_MauricioCalderon/meta-openembedded/meta-python \
  "
```
